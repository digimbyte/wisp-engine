// Example: Pokemon Red/Blue style RPG using Wisp Partitioned Database V2
#include "../../include/wisp_app_interface.h"
#include "../engine/wisp_partitioned_db_v2.h"

// ROM data definition (this would normally be generated by build tools)
const uint8_t POKEMON_ROM_DATA[] = {
    // Magic header for ROM partition
    0x52, 0x4F, 0x4D, 0x01,  // 'ROM' + version
    
    // Item definitions (preloaded at compile time)
    // Format: [key:4][type:1][size:1][data:variable]
    
    // Pokeball definition
    0x01, 0x01, 0x01, 0x01,  // key: NS_GAME.CAT_ITEMS.1 (POKEBALL)
    0x06, 0x08,              // type: STRUCT, size: 8 bytes
    0x01, 0x01, 0x64, 0x00, 0x05, 0x00, 0x00, 0x00, // type:1, rarity:1, value:100, properties:5
    
    // Potion definition  
    0x01, 0x01, 0x0A, 0x01,  // key: NS_GAME.CAT_ITEMS.10 (POTION)
    0x06, 0x08,              // type: STRUCT, size: 8 bytes
    0x03, 0x01, 0x19, 0x00, 0x14, 0x00, 0x00, 0x00, // type:3, rarity:1, value:25, properties:20hp
    
    // Quest definitions
    0x01, 0x02, 0xE8, 0x03,  // key: NS_GAME.CAT_QUESTS.1000 (STARTER_POKEMON)
    0x05, 0x17,              // type: STRING, size: 23 bytes
    'C', 'h', 'o', 'o', 's', 'e', ' ', 'Y', 'o', 'u', 'r', ' ',
    'S', 't', 'a', 'r', 't', 'e', 'r', ' ', 'P', 'o', 'k', 'e',
    'm', 'o', 'n', 0x00,
    
    // End marker
    0x00, 0x00, 0x00, 0x00
};

class PokemonRPG : public WispApp {
private:
    uint32_t lastUpdate;
    uint8_t gameState;
    bool romLoaded;
    
    enum GameStates {
        STATE_INTRO = 0,
        STATE_OVERWORLD = 1,
        STATE_BATTLE = 2,
        STATE_MENU = 3,
        STATE_SAVE = 4
    };
    
public:
    PokemonRPG() : lastUpdate(0), gameState(STATE_INTRO), romLoaded(false) {}
    
    const char* getName() override { return "Pokemon RPG V2"; }
    const char* getVersion() override { return "2.0.0"; }
    uint8_t getTargetFPS() override { return 10; }
    uint32_t getMemoryRequirement() override { return 32768; }
    
    bool init() override {
        Serial.println("=== Pokemon RPG V2 Starting ===");
        
        // Initialize partitioned database
        if (!wispDB.initialize()) {
            Serial.println("ERROR: Failed to initialize database");
            return false;
        }
        
        // Load ROM data (compile-time baked game content)
        if (!wispDB.loadROMData(POKEMON_ROM_DATA, sizeof(POKEMON_ROM_DATA))) {
            Serial.println("ERROR: Failed to load ROM data");
            return false;
        }
        romLoaded = true;
        
        // Check if this is a new game
        if (!gameDB.hasExistingSave()) {
            setupNewGame();
        } else {
            gameDB.loadGame();
            Serial.println("Loaded existing save game");
        }
        
        // Print database statistics
        wispDB.printStats();
        
        return true;
    }
    
    void setupNewGame() {
        Serial.println("Setting up new Pokemon adventure...");
        
        // Initialize player stats using new API
        WISP_SET_PLAYER_LEVEL(5);
        WISP_ADD_MONEY(3000);
        wispDB.setU16(WISP_PLAYER_HP, 100);
        WISP_SET_POSITION(MAP_PALLET_TOWN, 10, 10);
        
        // Give starting items
        WISP_GIVE_ITEM(ITEM_POKEBALL, 5);
        WISP_GIVE_ITEM(ITEM_POTION, 3);
        wispDB.setString(WISP_KEY_MAKE(NS_PLAYER, CAT_STATS, 20), "Red"); // Player name
        
        // Start with first quest
        gameDB.startQuest(QUEST_STARTER_POKEMON);
        
        // Add starter Pokemon to party slot 1
        WispGameDB::Pokemon starter = {
            .species = 1,    // Bulbasaur
            .level = 5,
            .happiness = 70,
            .experience = 0,
            .hp = 45, .attack = 49, .defense = 49, .speed = 45,
            .moves = 0x21000000, // Tackle + Growl (moves 33, 1)
            .nature = 1,
            .ability = 1
        };
        
        gameDB.addPokemon(1, starter);
        
        Serial.println("New game setup complete!");
        printGameStatus();
    }
    
    void update(uint32_t deltaTime) override {
        lastUpdate += deltaTime;
        
        // Simple game loop
        switch (gameState) {
            case STATE_INTRO:
                if (lastUpdate > 3000) { // Skip intro after 3 seconds
                    gameState = STATE_OVERWORLD;
                    lastUpdate = 0;
                }
                break;
                
            case STATE_OVERWORLD:
                updateOverworld();
                break;
                
            case STATE_BATTLE:
                updateBattle();
                break;
                
            case STATE_MENU:
                updateMenu();
                break;
                
            case STATE_SAVE:
                saveGame();
                gameState = STATE_OVERWORLD;
                break;
        }
        
        // Auto-save every 30 seconds
        if (lastUpdate > 30000) {
            gameDB.saveGame();
            lastUpdate = 0;
        }
    }
    
    void updateOverworld() {
        static uint32_t lastEvent = 0;
        
        if (millis() - lastEvent > 5000) { // Event every 5 seconds
            simulateGameplayEvent();
            lastEvent = millis();
        }
        
        // Check quest completion
        if (gameDB.isQuestActive(QUEST_STARTER_POKEMON) && 
            gameDB.getPokemonCount() > 0) {
            gameDB.completeQuest(QUEST_STARTER_POKEMON);
            gameDB.startQuest(QUEST_FIRST_GYM);
            Serial.println("Quest completed: Choose Your Starter Pokemon!");
        }
    }
    
    void updateBattle() {
        // Simulate battle outcome
        static uint32_t battleStart = 0;
        if (battleStart == 0) battleStart = millis();
        
        if (millis() - battleStart > 3000) { // Battle lasts 3 seconds
            // Win battle - gain XP and money
            WISP_ADD_XP(150);
            WISP_ADD_MONEY(500);
            
            Serial.println("Battle won! Gained 150 XP and 500 money");
            
            // Level up if enough XP
            if (WISP_GET_XP() >= WISP_GET_PLAYER_LEVEL() * 100) {
                WISP_SET_PLAYER_LEVEL(WISP_GET_PLAYER_LEVEL() + 1);
                Serial.printf("Level up! Now level %d\n", WISP_GET_PLAYER_LEVEL());
            }
            
            gameState = STATE_OVERWORLD;
            battleStart = 0;
        }
    }
    
    void updateMenu() {
        // Return to overworld after showing menu
        gameState = STATE_OVERWORLD;
    }
    
    void simulateGameplayEvent() {
        uint8_t event = random(1, 7);
        
        switch (event) {
            case 1: // Wild Pokemon encounter
                if (WISP_HAS_ITEM(ITEM_POKEBALL, 1)) {
                    WISP_USE_ITEM(ITEM_POKEBALL, 1);
                    Serial.println("Caught a wild Pokemon!");
                } else {
                    Serial.println("No Pokeballs! Pokemon escaped!");
                }
                break;
                
            case 2: // Find item
                findRandomItem();
                break;
                
            case 3: // Trainer battle
                gameState = STATE_BATTLE;
                Serial.println("Trainer battle started!");
                break;
                
            case 4: // Gym battle
                attemptGymBattle();
                break;
                
            case 5: // Use potion
                if (WISP_HAS_ITEM(ITEM_POTION, 1)) {
                    WISP_USE_ITEM(ITEM_POTION, 1);
                    Serial.println("Used a Potion!");
                }
                break;
                
            case 6: // Move to new location
                moveToNewLocation();
                break;
        }
    }
    
    void findRandomItem() {
        uint16_t items[] = {ITEM_POKEBALL, ITEM_POTION, ITEM_RARE_CANDY};
        uint16_t itemId = items[random(0, 3)];
        
        WISP_GIVE_ITEM(itemId, 1);
        Serial.printf("Found item %d!\n", itemId);
    }
    
    void attemptGymBattle() {
        uint8_t level = WISP_GET_PLAYER_LEVEL();
        uint8_t badges = gameDB.getBadgeCount();
        
        if (badges < 8 && level >= (badges + 1) * 8) { // Need level 8, 16, 24... for each gym
            gameDB.earnBadge(badges + 1);
            WISP_ADD_XP(500);
            WISP_ADD_MONEY(2000);
            
            Serial.printf("Won gym battle! Earned badge %d!\n", badges + 1);
            
            if (badges == 0 && gameDB.isQuestActive(QUEST_FIRST_GYM)) {
                gameDB.completeQuest(QUEST_FIRST_GYM);
                gameDB.startQuest(QUEST_RIVAL_BATTLE_1);
                Serial.println("First gym quest completed!");
            }
        } else {
            Serial.printf("Not ready for gym (Level: %d, Badges: %d)\n", level, badges);
        }
    }
    
    void moveToNewLocation() {
        uint16_t newMap = random(MAP_PALLET_TOWN, MAP_INDIGO_PLATEAU + 1);
        uint16_t x = random(5, 20);
        uint16_t y = random(5, 20);
        
        WISP_SET_POSITION(newMap, x, y);
        Serial.printf("Moved to map %d at (%d, %d)\n", newMap, x, y);
    }
    
    void saveGame() {
        gameDB.saveGame();
        Serial.println("Game saved!");
    }
    
    void render() override {
        static uint32_t lastPrint = 0;
        
        if (millis() - lastPrint > 10000) { // Every 10 seconds
            printGameStatus();
            lastPrint = millis();
        }
    }
    
    void printGameStatus() {
        Serial.println("\n=== Pokemon RPG Status ===");
        Serial.printf("Player: %s, Level: %d, XP: %d, Money: %d\n",
                     wispDB.getString(WISP_KEY_MAKE(NS_PLAYER, CAT_STATS, 20), "Unknown").c_str(),
                     WISP_GET_PLAYER_LEVEL(),
                     WISP_GET_XP(),
                     WISP_GET_MONEY());
        
        uint16_t map, x, y;
        gameDB.getPlayerPosition(&map, &x, &y);
        Serial.printf("Location: Map %d at (%d, %d)\n", map, x, y);
        
        Serial.printf("Pokemon: %d, Badges: %d\n", 
                     gameDB.getPokemonCount(),
                     gameDB.getBadgeCount());
        
        Serial.printf("Items - Pokeballs: %d, Potions: %d\n",
                     WISP_ITEM_COUNT(ITEM_POKEBALL),
                     WISP_ITEM_COUNT(ITEM_POTION));
        
        Serial.printf("Active Quests: %d\n", gameDB.getActiveQuests().size());
        
        // Show cache performance
        Serial.printf("Cache Hit Ratio: %.1f%%\n", wispDB.getCacheHitRatio() * 100.0f);
    }
    
    void handleInput(uint8_t button, bool pressed) override {
        if (!pressed) return;
        
        switch (button) {
            case 0: // Menu
                gameState = STATE_MENU;
                Serial.println("=== MENU ===");
                printGameStatus();
                break;
                
            case 1: // Save
                gameState = STATE_SAVE;
                break;
                
            case 2: // Battle
                gameState = STATE_BATTLE;
                Serial.println("Starting trainer battle!");
                break;
                
            case 3: // Debug stats
                wispDB.printStats();
                wispDB.printCacheStats();
                wispDB.printMemoryMap();
                break;
        }
    }
    
    void cleanup() override {
        gameDB.saveGame();
        Serial.println("Pokemon RPG V2 shutting down...");
        
        // Final stats
        Serial.printf("Total play time: %d seconds\n", gameDB.getPlayTime());
        wispDB.printStats();
    }
};

// App factory function
extern "C" WispApp* createWispApp() {
    return new PokemonRPG();
}
